## poky/build/conf/bblayers.conf
```bitbake
# POKY_BBLAYERS_CONF_VERSION is increased each time build/conf/bblayers.conf
# changes incompatibly
POKY_BBLAYERS_CONF_VERSION = "2"

BBPATH = "${TOPDIR}"
BBFILES ?= ""

BBLAYERS ?= " \
  /home/mahendran/projects/rpi_yocto/poky/meta \
  /home/mahendran/projects/rpi_yocto/poky/meta-poky \
  /home/mahendran/projects/rpi_yocto/poky/meta-yocto-bsp \
  /home/mahendran/projects/rpi_yocto/poky/meta-openembedded/meta-oe \
  /home/mahendran/projects/rpi_yocto/poky/meta-raspberrypi \
  /home/mahendran/projects/rpi_yocto/poky/meta-custom \
  "
```

## poky/meta-custom/conf/layer.conf
```bitbake
BBPATH .= ":${LAYERDIR}"

# We have a recipes directory containing .bb and .bbappend files, add to BBFILES
BBFILES += "${LAYERDIR}/recipes*/*/*.bb \
            ${LAYERDIR}/recipes*/*/*.bbappend"

BBFILE_COLLECTIONS += "custom"
BBFILE_PATTERN_custom := "^${LAYERDIR}/"
BBFILE_PRIORITY_custom = "20"

LAYERSERIES_COMPAT_custom = "scarthgap"
LAYERDEPENDS_custom = "core"

#
# The .bbappend and .bb files are included if the respective layer
# collection is available.
BBFILES += "${@' '.join('${LAYERDIR}/dynamic-layers/%s/recipes*/*/*.bbappend' % layer \
               for layer in BBFILE_COLLECTIONS.split())}"
BBFILES += "${@' '.join('${LAYERDIR}/dynamic-layers/%s/recipes*/*/*.bb' % layer \
               for layer in BBFILE_COLLECTIONS.split())}"

BBFILES_DYNAMIC += " \
    openembedded-layer:${LAYERDIR}/dynamic-layers/openembedded-layer/*/*/*.bb \
    openembedded-layer:${LAYERDIR}/dynamic-layers/openembedded-layer/*/*/*.bbappend \
"
```
